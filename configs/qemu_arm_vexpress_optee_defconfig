## configs/qemu_arm_vexpress_optee_defconfig
```kconfig
BR2_arm=y
BR2_cortex_a9=y
BR2_ARM_ENABLE_NEON=y
BR2_ARM_ENABLE_VFP=y
BR2_CCACHE=y
BR2_CCACHE_DIR="$(HOME)/.ccache"
BR2_TOOLCHAIN_EXTERNAL=y
BR2_TARGET_GENERIC_GETTY_PORT="ttyAMA0"
BR2_SYSTEM_DHCP="eth0"
BR2_ROOTFS_USERS_TABLES="board/qemu/arm-vexpress-optee/users_table.txt"
BR2_ROOTFS_OVERLAY="board/qemu/arm-vexpress-optee/rootfs_overlay"
BR2_ROOTFS_POST_BUILD_SCRIPT="board/qemu/arm-vexpress-optee/post-build.sh"
BR2_PACKAGE_LTRACE=y
BR2_PACKAGE_STRACE=y
BR2_PACKAGE_VALGRIND=y
BR2_PACKAGE_OPENSSH=y
BR2_TARGET_ROOTFS_CPIO=y
BR2_TARGET_ROOTFS_CPIO_GZIP=y
```
